## meta-eshine/conf/layer.conf
```bitbake
# SPDX-License-Identifier: Apache-2.0
# Copyright (c) 2026 Julian Chu

# 站三十四:eshine-os 的 Yocto 层。参考实现与工具链的 60 补丁战争
# 不重演——本层零补丁:构建吃 git archive 提交树(scripts/
# archive-source.sh 机制),交叉工具链走宿主四件(HOSTTOOLS
# 白名单制;gcc-cross 内建=后弧,v0 政策记档 spec §2)。

BBPATH =. "${LAYERDIR}:"
BBFILES += "${LAYERDIR}/recipes-*/*/*.bb \
            ${LAYERDIR}/recipes-*/*/*.bbappend"

BBFILE_COLLECTIONS += "eshine"
BBFILE_PATTERN_eshine = "^${LAYERDIR}/"
BBFILE_PRIORITY_eshine = "6"

LAYERSERIES_COMPAT_eshine = "scarthgap"

# 宿主交叉四件入白名单(bitbake 沙盒 PATH 以 HOSTTOOLS 符号链接
# 制实现;缺列=do_compile "command not found" 面)
HOSTTOOLS += "aarch64-linux-gnu-gcc aarch64-linux-gnu-ld \
              aarch64-linux-gnu-objcopy aarch64-linux-gnu-ar"
```

## meta-eshine/conf/machine/eshine-qemu-a57-type1.conf
```bitbake
# SPDX-License-Identifier: Apache-2.0
# Copyright (c) 2026 Julian Chu

# 站六十一:目标机定义——eshine-os on QEMU virt(AArch64,cortex-a57
# 四核,type-1 部署形态)。镜像配方(eshine-image.bb)读此面变量生成
# 终装 run.sh(启动参数单一事实源=机器定义,非散落脚本)。

require conf/machine/include/arm/arch-armv8a.inc

MACHINEOVERRIDES =. "eshine-qemu-a57-type1:"

# 部署形态(QEMU 调用面;与 tools/verify/smoke.py 同一构建语义)
ESHINE_QEMU_MACHINE = "virt,virtualization=on,gic-version=3"
ESHINE_QEMU_CPU = "cortex-a57"
ESHINE_QEMU_MEMORY = "512"
ESHINE_QEMU_CPUS = "4"
ESHINE_QEMU_KERNEL_ADDR = "0x50000000"
ESHINE_QEMU_GUEST2_ADDR = "0x51000000"
```
